#include <EEPROM.h>
#include <Wire.h>
#include <Adafruit_SSD1306.h>
#include <TinyGPSPlus.h>

// 'bitmap', 128x64px
const unsigned char pakistan_flag [] PROGMEM = {
  0xff, 0xff, 0xff, 0xff, 0x00, 0x00, 0x00, 0x00, 0x00, 0x00, 0x00, 0x00, 0x00, 0x00, 0x00, 0x00,
  0xff, 0xff, 0xff, 0xff, 0x00, 0x00, 0x00, 0x00, 0x00, 0x00, 0x00, 0x00, 0x00, 0x00, 0x00, 0x00,
  0xff, 0xff, 0xff, 0xff, 0x00, 0x00, 0x00, 0x00, 0x00, 0x00, 0x00, 0x00, 0x00, 0x00, 0x00, 0x00,
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  0xff, 0xff, 0xff, 0xff, 0x00, 0x00, 0x00, 0x00, 0x00, 0x00, 0x00, 0x00, 0x00, 0x00, 0x00, 0x00
};

// 'allah_bitmap', 128x64px
const unsigned char allah [] PROGMEM = {
  0xff, 0xff, 0xff, 0xff, 0xff, 0xff, 0xff, 0xff, 0xff, 0xff, 0xff, 0xff, 0xff, 0xff, 0xff, 0xff,
  0xff, 0xff, 0xff, 0xff, 0xff, 0xff, 0xff, 0xff, 0xff, 0xff, 0xff, 0xff, 0xff, 0xff, 0xff, 0xff,
  0xff, 0xff, 0xff, 0xff, 0xff, 0xff, 0xff, 0xff, 0xff, 0xff, 0xff, 0xff, 0xff, 0xff, 0xff, 0xff,
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  0xff, 0xff, 0xff, 0xff, 0xff, 0xff, 0xff, 0xff, 0xff, 0xff, 0xff, 0xff, 0xff, 0xff, 0xff, 0xff
};

Adafruit_SSD1306 led(128, 64, &Wire, -1);
TinyGPSPlus gps;

unsigned long prevTime = 0;
unsigned int diskCounter = 0;
float lat = 0.0;
float lng = 0.0;
float speed = 0.0;
byte hour = 0;
byte minute = 0;
byte second = 0;
byte numOfSats = 0;
float alttitude = 0;

void storeLocation (float lat, float lng) {
  EEPROM.put(diskCounter, lat);
  diskCounter += sizeof(float);

  EEPROM.put(diskCounter, lng);
  diskCounter += sizeof(float);
}

void displayTime(byte hour, byte minute, byte second) {
  
  if (hour < 10) led.print('0');
  led.print(hour);
  led.print(':');
  
  if (minute < 10) led.print('0');
  led.print(minute);
  led.print(':');
 
  if (second < 10) led.print('0');
  led.println(second);
}

void setup() {
  Serial.begin(9600);
  led.begin(SSD1306_SWITCHCAPVCC, 0x3C);
  led.clearDisplay();
  
  led.drawBitmap(0, 0, allah, 128, 64, 1);
  led.display();
  delay(3000);
 
  led.clearDisplay();
  led.drawBitmap(0, 0, pakistan_flag, 128, 64, 1);
  led.display();
  delay(3000);
  
  led.setTextColor(SSD1306_WHITE);
}

void loop() {
  led.clearDisplay();
  led.setCursor(0, 0);

  while (Serial.available()) {
    gps.encode(Serial.available());

    if (gps.time.isValid() &&
        gps.location.isValid() &&
        gps.speed.isValid() &&
        gps.satellites.isValid())
    {
      hour = gps.time.hour();
      minute = gps.time.minute();
      second = gps.time.second();

      lat = gps.location.lat();
      lng = gps.location.lng();
      speed = gps.speed.kmph();

      numOfSats = gps.satellites.value();
    }
  }

  if (millis() - prevTime >= 15000 && lat != 0.0 && lng != 0.0) {

    if (diskCounter < EEPROM.length()) storeLocation(lat, lng);
    prevTime = millis();
  }

  led.setTextSize(2);
  led.print(speed);
  led.println(" kmph");

  displayTime(hour, minute, second);

  led.setTextSize(1);
  led.print("Disk: ");
  led.print((float) diskCounter / 1024.0 * 100.0, 0);
  led.println('%');

  led.print("Alt: ");
  led.println(alttitude, 2);

  led.print("Sats: ");
  led.println(numOfSats);
  led.display();
}
